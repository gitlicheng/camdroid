## lichee/linux-3.4/drivers/char/sunxi_id/Kconfig
```kconfig
#
# sunxi continous physic memory allocator.
#

config ID
	bool "sunxi  id "
	default y
	help
	Nothing help.
```

## lichee/linux-3.4/drivers/char/sunxi_ir_cut/Kconfig
```kconfig
#
# sunxi continous physic memory allocator.
#

config IR_CUT
	bool "sunxi IR CUT "
	default y
	help
	Nothing help.
```

## lichee/linux-3.4/drivers/net/wireless/rtl8188_smart/Kconfig
```kconfig
config RTL8188_SMART
	tristate "Realtek 8188 smart link USB WiFi"
	depends on USB
	---help---
	  Help message of RTL8188_SMART
```

## lichee/linux-3.4/drivers/net/wireless/rtl8189_smart/Kconfig
```kconfig
config RTL8189_SMART
	tristate "Realtek 8189E smart link SDIO WiFi"
	depends on MMC
	---help---
	  Help message of RTL8189_SMART
```
